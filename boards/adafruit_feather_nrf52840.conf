## boards/adafruit_feather_nrf52840.conf
```kconfig
# Enable Bluetooth
CONFIG_BT=y
CONFIG_BT_PERIPHERAL=y
CONFIG_BT_DEVICE_NAME="feathermouse"

# Enable HID
CONFIG_BT_HIDS=y

# Key scanning
CONFIG_ZMK_KSCAN=y

# Disable stuff you don't need
CONFIG_ZMK_RGB_UNDERGLOW=n
CONFIG_ZMK_BACKLIGHT=n
CONFIG_ZMK_DISPLAY=n

# Reduce power usage
CONFIG_LED=n

# Output UF2
CONFIG_BUILD_OUTPUT_UF2=y 
```
