/ {
    chosen {
        zmk,kscan = &kscan0;
    };

    kscan0: kscan {
        compatible = "zmk,kscan-gpio-direct";
        label = "KSCAN";
        input-gpios = <
            &gpio0 11 (GPIO_PULL_UP | GPIO_ACTIVE_LOW)
        >;
    };
};
