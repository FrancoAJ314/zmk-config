## boards/arm/feather_mouse/Kconfig.board
```kconfig
config BOARD_FEATHER_MOUSE
    bool "feather_mouse"
    depends on SOC_NRF52840_QIAA
```

## boards/shields/feather_mouse/Kconfig.defconfig
```kconfig
if SHIELD_FEATHER_MOUSE

config ZMK_KEYBOARD_NAME
    string
    default "Feather Mouse"

endif
```
